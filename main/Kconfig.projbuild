## main/Kconfig.projbuild
```kconfig
menu "Example Configuration"
 
    config PIN_NUM_MOSI
        int "MOSI pin"
        range 0 48
        default 23
        help
            MOSI pin
 
    config PIN_NUM_MISO
        int "MISO pin"
        range 0 48
        default 16
        help
            MISO pin
 
    config PIN_NUM_CLK
        int "CLK pin"
        range 0 48
        default 25
        help
            CLK pin
 
    config PIN_NUM_CS
        int "CS pin"
        range 0 48
        default 15
        help
            CS pin
 
    config PIN_NUM_DC
        int "DC pin"
        range 0 48
        default 2
        help
            DC pin
 
    config PIN_NUM_BCKL
        int "BCKL pin"
        range 0 48
        default 25
        help
            BCKL pin
 
    config PIN_NUM_RST
        int "RST pin"
        range 0 48
        default 12
        help
            RST pin
 
endmenu
```
